## Config.in
```kconfig
menu "REG-build"

menu "Boot"
	source "$BR2_EXTERNAL_REGLINUX_PATH/package/boot/plymouth/Config.in"
endmenu

menu "Engines"
	source "$BR2_EXTERNAL_REGLINUX_PATH/package/engines/scummvm/Config.in"
endmenu

menu "System"
	source "$BR2_EXTERNAL_REGLINUX_PATH/package/system/reglinux-msg/Config.in"
endmenu
endmenu
```

## package/system/reglinux-msg/Config.in
```kconfig
config BR2_PACKAGE_REGLINUX_MSG
	bool "reglinux-msg"
	select BR2_PACKAGE_HOST_RUSTC_TARGET_ARCH_SUPPORTS
	select BR2_PACKAGE_HOST_RUSTC
	select BR2_PACKAGE_LIBDRM

	help
	  Manages screen resolution and display settings

	  https://github.com/REG-Linux/regmsg
```
